## board/Kconfig
```kconfig
menu "Hardware Drivers Config"

config SOC_STM32F103ZE
    bool
    select SOC_SERIES_STM32F1
    select RT_USING_COMPONENTS_INIT
    select RT_USING_USER_MAIN
    default y

menu "Onboard Peripheral Drivers"

    config BSP_USING_TIMER
    bool "Enable onboard timer"
    select RT_USING_TIMER_SOFT
    select PKG_USING_MESSAGEQUEUE
    default n

    config BSP_USING_KEY
    bool "Enable onboard keys"
    select RT_USING_PIN
    select RT_USING_TIMER_SOFT
    select PKG_USING_FLEXIBLE_BUTTON
    default n

    config BSP_USING_LED
    bool "Enable onboard leds"
    select RT_USING_PIN
    default n

    config BSP_USING_BEEP
    bool "Enable onboard beep"
    select RT_USING_PIN
    select PKG_USING_BEEP
    default n

    config BSP_USING_ESP01S
    bool "Enable onboard esp01s"
    select RT_USING_PIN
    select BSP_USING_UART3
    if BSP_USING_ESP01S
    config ESP01S_UART_NAME
    string "the serial port for esp01s"
    default "uart3"
    default n
    help
        If you select "BSP_USING_ESP01S" Please select "uart3".
    endif

    config BSP_USING_PCF8574
    bool "Enable onboard pcf8574"
    select RT_USING_PIN
    select BSP_USING_I2C1
    select PKG_USING_PCF8574
    default n

    config BSP_USING_AT24CXX
    bool "Enable onboard at24cxx"
    select RT_USING_PIN
    select BSP_USING_I2C1
    select PKG_USING_AT24CXX_BY_ROY
    default n

    menuconfig BSP_USING_AHT10
    bool "Enable onboard aht10"
    select RT_USING_PIN
    select BSP_USING_I2C1
    select PKG_USING_AHT10_BY_ROY
    default n
    if BSP_USING_AHT10
    config USING_SOFT_FILTER
    bool "Use_soft_filter"
    select PKG_USING_KALMANFILTER
    default n
    endif

    config BSP_USING_SPI_FLASH
    bool "Enable SPI FLASH (W25Q128 spi2)"
    select BSP_USING_SPI
    select BSP_USING_SPI2
    select RT_USING_SFUD
    select RT_SFUD_USING_SFDP
    default n
    
endmenu

menu "On-chip Peripheral Drivers"

    config BSP_USING_GPIO
        bool "Enable GPIO"
        select RT_USING_PIN
        default y

    menuconfig BSP_USING_ON_CHIP_FLASH
        bool "Enable on-chip FLASH"
        default n
        if BSP_USING_ON_CHIP_FLASH
            config BSP_CHIP_FLASH_TEST_SAMPLE
                bool "TEST_SAMPLE"
                default n
        endif
# ---------------------UART--------------------- #
    menuconfig BSP_USING_UART
        bool "Enable UART"
        default y
        select RT_USING_SERIAL
        if BSP_USING_UART

            config BSP_USING_UART1
                bool "Enable UART1"
                default y

            config BSP_UART1_RX_USING_DMA
                bool "Enable UART1 RX DMA"
                depends on BSP_USING_UART1 && RT_SERIAL_USING_DMA
                default n

            config BSP_USING_UART2
                bool "Enable UART2"
                default n

            config BSP_UART2_RX_USING_DMA
                bool "Enable UART2 RX DMA"
                depends on BSP_USING_UART2 && RT_SERIAL_USING_DMA
                default n

            config BSP_USING_UART3
                bool "Enable UART3"
                select RT_USING_PIN
                default n

            config BSP_UART3_RX_USING_DMA
                bool "Enable UART3 RX DMA"
                depends on BSP_USING_UART3 && RT_SERIAL_USING_DMA
                default n
        endif
# ---------------------I2C--------------------- #
    menuconfig BSP_USING_I2C1
    bool "Enable I2C1 BUS (software simulation)"
    default n
    select RT_USING_I2C
    select RT_USING_I2C_BITOPS
    select RT_USING_PIN
    if BSP_USING_I2C1
        comment "Notice: PB6 --> 22; PB7 --> 23"
        config BSP_I2C1_SCL_PIN
            int "I2C1 scl pin number"
            range 22 22
            default 22
            help
            Fixed to PB6 (22).
        config BSP_I2C1_SDA_PIN
            int "I2C1 sda pin number"
            range 23 23
            default 23
            help
            Fixed to PB7 (23).
    endif

    menuconfig BSP_USING_SPI
    bool "Enable SPI BUS"
    default n
    select RT_USING_SPI
    if BSP_USING_SPI
        config BSP_USING_SPI1
            bool "Enable SPI1 BUS"
            default n

        config BSP_SPI1_TX_USING_DMA
            bool "Enable SPI1 TX DMA"
            depends on BSP_USING_SPI1
            default n
            
        config BSP_SPI1_RX_USING_DMA
            bool "Enable SPI1 RX DMA"
            depends on BSP_USING_SPI1
            select BSP_SPI1_TX_USING_DMA
            default n

        config BSP_USING_SPI2
            bool "Enable SPI2 BUS"
            default n  
            
        config BSP_SPI2_TX_USING_DMA
            bool "Enable SPI2 TX DMA"
            depends on BSP_USING_SPI2
            default n
            
        config BSP_SPI2_RX_USING_DMA
            bool "Enable SPI2 RX DMA"
            depends on BSP_USING_SPI2
            select BSP_SPI2_TX_USING_DMA
            default n
    endif
    source "../libraries/HAL_Drivers/Kconfig"

endmenu

menu "Board extended module Drivers"

endmenu

endmenu
```
